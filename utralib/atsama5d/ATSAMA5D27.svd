# ATSAMA5D27 register map
Vendor: Microchip Technology Inc.; File version: 1.0
CPU: CA5 r0p1, little endian, no MPU, no FPU, 4 interrupt priority bits
Address unit: 32 bits
Registers are 32-bit, read-write, reset 0x0 unless marked. A register's access mark holds for its fields unless they carry their own. Offsets are from the block's base; lines under a group give offsets from that group; [hi:lo] are bit positions; {n}, {i} and the like mark numbered series; 'fields as' and 'values as' point back to an identical list; <NAME> marks a mode.

## Memory map
0x00400000 UHPHS_OHCI size 0x1000
0x00500000 UHPHS_EHCI size 0x1000
0x00600000 AXIMX size 0x4 — AXI Matrix
0x00A00000 L2CC blocks up to offset 0xF84 — L2 Cache Controller
0xA0000000 SDMMC0 blocks up to offset 0x244 — Secure Digital MultiMedia Card Controller
0xB0000000 SDMMC1 blocks up to offset 0x244 — Secure Digital MultiMedia Card Controller
0xF0000000 LCDC blocks up to offset 0x1204 — LCD Controller
0xF0004000 XDMAC1 size 0x44 — Extensible DMA Controller
0xF0008000 ISC blocks up to offset 0x414 — Image Sensor Controller
0xF000C000 MPDDRC blocks up to offset 0xEC — AHB Multiport DDR-SDRAM Controller
0xF0010000 XDMAC0 size 0x44 — Extensible DMA Controller
0xF0014000 PMC blocks up to offset 0x154 — Power Management Controller
0xF0018000 MATRIX0 blocks up to offset 0x2C4 — AHB Bus Matrix
0xF001C000 AESB blocks up to offset 0x64 — Advanced Encryption Standard Bridge
0xF0020000 QSPI0 blocks up to offset 0xEC — Quad Serial Peripheral Interface
0xF0024000 QSPI1 blocks up to offset 0xEC — Quad Serial Peripheral Interface
0xF0028000 SHA blocks up to offset 0x84 — Secure Hash Algorithm
0xF002C000 AES blocks up to offset 0xD4 — Advanced Encryption Standard
0xF8000000 SPI0 blocks up to offset 0xEC — Serial Peripheral Interface
0xF8004000 SSC0 blocks up to offset 0xEC — Synchronous Serial Controller
0xF8008000 GMAC blocks up to offset 0x6E4 — Gigabit Ethernet MAC
0xF800C000 TC0 blocks up to offset 0x28 — Timer Counter
0xF8010000 TC1 blocks up to offset 0x28 — Timer Counter
0xF8014000 SMC blocks up to offset 0x7EC — Static Memory Controller
0xF8018000 PDMIC blocks up to offset 0xEC — Pulse Density Modulation Interface Controller
0xF801C000 UART0 blocks up to offset 0xE8 — Universal Asynchronous Receiver Transmitter
0xF8020000 UART1 blocks up to offset 0xE8 — Universal Asynchronous Receiver Transmitter
0xF8024000 UART2 blocks up to offset 0xE8 — Universal Asynchronous Receiver Transmitter
0xF8028000 TWIHS0 blocks up to offset 0xEC — Two-wire Interface High Speed
0xF802C000 PWM blocks up to offset 0x464 — Pulse Width Modulation Controller
0xF8030000 SFR blocks up to offset 0x94 — Special Function Registers
0xF8034000 FLEXCOM0 blocks up to offset 0x6EC — Flexible Serial Communication
0xF8038000 FLEXCOM1 blocks up to offset 0x6EC — Flexible Serial Communication
0xF803C000 SAIC blocks up to offset 0xEC — Advanced Interrupt Controller
0xF8040000 ICM blocks up to offset 0x3C — Integrity Check Monitor
0xF8048000 RSTC size 0xC — Reset Controller
0xF8048010 SHDWC size 0x10 — Shutdown Controller
0xF8048030 PIT size 0x10 — Periodic Interval Timer
0xF8048040 WDT size 0xC — Watchdog Timer
0xF8048050 SCKC size 0x4 — Slow Clock Controller
0xF80480B0 RTC size 0x30 — Real-time Clock
0xF8049000 RXLP blocks up to offset 0xE8 — Low Power Asynchronous Receiver
0xF804A000 ACC blocks up to offset 0xEC — Analog Comparator Controller
0xF804C000 SFC blocks up to offset 0x24 — Secure Fuse Controller
0xF8050000 I2SC0 size 0x28 — Inter-IC Sound Controller
0xF8054000 MCAN0 blocks up to offset 0xFC — Controller Area Network
0xFC000000 SPI1 blocks up to offset 0xEC — Serial Peripheral Interface
0xFC004000 SSC1 blocks up to offset 0xEC — Synchronous Serial Controller
0xFC008000 UART3 blocks up to offset 0xE8 — Universal Asynchronous Receiver Transmitter
0xFC00C000 UART4 blocks up to offset 0xE8 — Universal Asynchronous Receiver Transmitter
0xFC010000 FLEXCOM2 blocks up to offset 0x6EC — Flexible Serial Communication
0xFC014000 FLEXCOM3 blocks up to offset 0x6EC — Flexible Serial Communication
0xFC018000 FLEXCOM4 blocks up to offset 0x6EC — Flexible Serial Communication
0xFC01C000 TRNG blocks up to offset 0x54 — True Random Number Generator
0xFC020000 AIC blocks up to offset 0xEC — Advanced Interrupt Controller
0xFC028000 TWIHS1 blocks up to offset 0xEC — Two-wire Interface High Speed
0xFC02C000 UDPHS blocks up to offset 0xFC — USB High Speed Device Port
0xFC030000 ADC blocks up to offset 0xEC — Analog-to-Digital Converter
0xFC038000 PIO size 0x1000 — Parallel Input/Output Controller.
0xFC039000 SPIO size 0x1000 — Parallel Input/Output Controller.
0xFC03C000 MATRIX1 blocks up to offset 0x2C4 — AHB Bus Matrix
0xFC040000 SECUMOD blocks up to offset 0x94 — Security Module
0xFC044000 TDES blocks up to offset 0x74 — Triple Data Encryption Standard
0xFC048000 CLASSD blocks up to offset 0xE8 — Audio Class D Amplifier (CLASSD)
0xFC04C000 I2SC1 size 0x28 — Inter-IC Sound Controller
0xFC050000 MCAN1 blocks up to offset 0xFC — Controller Area Network
0xFC05C000 SFRBU blocks up to offset 0x18 — Special Function Registers Backup
0xFC060028 PTC blocks up to offset 0xE — Peripheral Touch Controller
0xFC069000 CHIPID size 0x8 — Chip Identifier

## Further device data
memoryRegions:
  DDR_RAM baseAddress=0x20000000 size=0x8000000
  ENCRYPTED_RAM baseAddress=0x40000000 size=0x8000000
  SDMMC0 baseAddress=0xA0000000 size=0x1000
  CSR1 baseAddress=0xF0000000 size=0x30000
  CSR2 baseAddress=0xf8000000 size=0x60000
  CSR3 baseAddress=0xfc000000 size=0x70000
  L2CC baseAddress=0x00a00000 size=0x4000
  SECURAM baseAddress=0xf8044000 size=0x1000
  BUREG baseAddress=0xf8045000 size=0x1000
  SRAM0 baseAddress=0x00200000 size=0x20000
  UDPHS_RAM baseAddress=0x00300000 size=0x100000
  UHPHS_OHCI baseAddress=0x00400000 size=0x1000
  UHPHS_EHCI baseAddress=0x00500000 size=0x1000
